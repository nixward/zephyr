## drivers/gpio/Kconfig.x4hc595
```kconfig
# Copyright (c) 2020 Nick Ward
# SPDX-License-Identifier: Apache-2.0

menuconfig GPIO_X4HC595
	bool "X4HC595 shift register driver"
	depends on GPIO || SPI
	help
	  Enable GPIO driver for X4HC595 shift register(s).

if GPIO_X4HC595

config GPIO_X4HC595_INIT_PRIORITY
	int "x4hc595 GPIO drive init priority"
	default 70
	help
	  X4HC595 GPIO driver init priority.

config GPIO_X4HC595_P0
	bool "x4hc595 GPIO Port 0"
	help
	  Enable X4HC595 GPIO port 0 config options.


endif # GPIO_X4HC595
```

## dts/bindings/gpio/ti,x4hc595-gpio.yaml
```yaml
# Copyright (c) 2020 Nick Ward
# SPDX-License-Identifier: Apache-2.0

description: X4HC595 output shift register

compatible: "ti,x4hc595-gpio"

include: [spi-device.yaml, gpio-controller.yaml]

properties:
    label:
      required: true

    "#gpio-cells":
      const: 2

    srclr-gpios:
      type: phandle-array
      required: false
      description: ￼>
        Shift Register Clear.

        Clears shift registers.  Is active when low.
    oe-gpios:
      type: phandle-array
      required: false
      description: ￼>
        Output Enable.

        Enables shift register outputs.  Is active when low.
    sr-cnt:
      type: int
      required: true
      description: >
        Shift register count.

        Between 1 to 4 shift registers.

gpio-cells:
  - pin
  - flags
```
